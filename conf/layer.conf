## conf/layer.conf
```bitbake
# We have a conf and classes directory, add to BBPATH
BBPATH .= ":${LAYERDIR}"

# We have a packages directory, add to BBFILES
BBFILES += "${LAYERDIR}/recipes-*/*/*.bb \
            ${LAYERDIR}/recipes-*/*/*.bbappend"

BBFILE_COLLECTIONS += "sota-opos6uldev"
BBFILE_PATTERN_sota-opos6uldev := "^${LAYERDIR}/"
BBFILE_PRIORITY_sota-opos6uldev = "4"

LAYERSERIES_COMPAT_sota-opos6uldev = "sumo"
LAYERDEPENDS_sota-opos6uldev = "core freescale-layer"
```
